## arch/arm/mach-rk30/Kconfig
```kconfig
if ARCH_RK30

choice
	prompt "RK30xx Board Type"
	default MACH_RK30_SDK

config MACH_RK30_SDK
	bool "RK30 SDK board"

config MACH_RK3066_SDK
	bool "RK3066 SDK board"

config MACH_RK30_DS1001B
        bool "RK30 DS1001B board"

config MACH_RK30_PHONE_PAD
        bool "RK30 smart phone pad board"
        
config MACH_RK30_PHONE
	bool "RK30 smart phone board"
	
##$_rbox_$_modify_begin
config MACH_RK30_BOX
	bool "RK30 itv box hamburger board"
	
config MACH_RK30_BOX_PIZZA
	bool "RK30 itv box pizza board"
	
config MACH_RK30_BOX_HOTDOG
	bool "RK30 itv box hotdog board"
		
##$_rbox_$_modify_end

config MACH_RK30_PHONE_LOQUAT
	bool "RK30 smart phone loquat board"

config MACH_RK30_PHONE_A22
        bool "RK30 smart phone a22 board"
	
endchoice

endif
```

## drivers/input/remotectl/Kconfig
```kconfig
#
# Touchscreen driver configuration
#
menuconfig ROCKCHIP_REMOTECTL
	bool "rkxx remotectl"
	default y
	help
	  Say Y here, will suport rk remotectl.
	  This option doesn't affect the kernel.
	  If unsure, say Y.
	  
if ROCKCHIP_REMOTECTL  

config RK_REMOTECTL
	tristate "rkxx remoctrl"
	default y
	
endif
```

## drivers/usb/ES603_driver/Kconfig
```kconfig
#
# USB OTG infrastructure may be needed for peripheral-only, host-only,
# or OTG-capable configurations when OTG transceivers or controllers
# are used.
#

comment "SS801 USB Protocol Driver"

config SS801_PROTOCOL_DRIVER
	tristate "SS801 PROTOCOL DRIVER"
        default n
	help
	  SS801 Protocol Driver
```

## drivers/usb/drv_es603usb/Kconfig
```kconfig
#
# USB OTG infrastructure may be needed for peripheral-only, host-only,
# or OTG-capable configurations when OTG transceivers or controllers
# are used.
#

comment "ES603 USB Protocol Driver"

config ES603_PROTOCOL_DRIVER
	tristate "ES603 PROTOCOL DRIVER"
	default n
	help
	  ES603 Protocol Driver
```

## drivers/video/display/Kconfig
```kconfig
#
# Display drivers configuration
#

menu "Display device support"

config DISPLAY_SUPPORT
	tristate "Display panel/monitor support"
	depends on FB_RK29 || FB_ROCKCHIP
	---help---
	  This framework adds support for low-level control of a display.
	  This includes support for power.

	  Enable this to be able to choose the drivers for controlling the
	  physical display panel/monitor on some platforms. This not only
	  covers LCD displays for PDAs but also other types of displays
	  such as CRT, TVout etc.

	  To have support for your specific display panel you will have to
	  select the proper drivers which depend on this option.

comment "Display hardware drivers"
	depends on DISPLAY_SUPPORT
source "drivers/video/display/screen/Kconfig"

#$_rbox_$_modify_$ zhy modified for box display system
source "drivers/video/display/lcd/Kconfig"
source "drivers/video/display/hdmi/Kconfig"
source "drivers/video/display/vga/Kconfig"
source "drivers/video/display/tve/Kconfig"

config DISPLAY_AUTO_SWITCH
	bool "Enable auto switch display interface"

config DISPLAY_KEY_LED_CONTROL
	bool "Enalbe Keyboard and Led Control"
	help
		Enable use led to indicate display interface.
		Enable use keyboard or remote controler to switch display interface or mode.
#$_rbox_$_modify_$_end
endmenu
```

## drivers/video/display/hdmi/Kconfig
```kconfig
#
# Display drivers configuration
#

menuconfig HDMI_ITV
	bool "HDMI support(itv version)"
    depends on FB_RK29 || FB_ROCKCHIP

source "drivers/video/display/hdmi/chips/Kconfig"

choice
	prompt "HDMI output mode select"
	depends on HDMI_ITV
config HDMI_MODE_ALWAYS_HDMI
	bool "always hdmi"
config HDMI_MODE_ALWAYS_DVI
	bool "always dvi"
config HDMI_MODE_DEPEND_EDID
	bool "depended on EDID"
endchoice

config HDMI_HDCP_ENABLE
	bool "HDMI HDCP Function Enable"
	depends on HDMI_ITV
	help
		select enable HDCP function.

config HDMI_USE_IRQ
	bool "Use IRQ Mode to Poll HDMI Status."
	depends on HDMI_ITV
	help
		If selected, use irq mode to poll HDMI status.
		If not selected, use poll mode to poll HDMI status.
		
if	ANX7150 && HDMI_USE_IRQ
choice
	prompt "ANX7150 IRQ type"
config ANX7150_IRQ_USE_RK29PIO
	bool "use rk29 pio to detect irq"
	
config ANX7150_IRQ_USE_CHIP
	bool "use anx7150 irq pin to detet irq"

endchoice
endif

config HDMI_DEBUG
	bool "HDMI Transmitter Debugging"
	depends on HDMI_ITV
	help
		Enableds verbose debugging the the HDMI Transmitter drivers.
```

## drivers/video/display/hdmi/chips/Kconfig
```kconfig
choice
	prompt "HDMI/MHL Transmitter Select"
	depends on HDMI_ITV
	
config ANX7150
	bool "Analogix HDMI transmitter ANX7150 support"
	depends on HDMI_ITV
	
config CAT6611
	bool "ITE HDMI transmitter IT6610 support"
	depends on HDMI_ITV
	
config IT66121
	bool "ITE HDMI transmitter IT66121 support(EXPERIMENTAL)"
	depends on HDMI_ITV
	
config SII902X
	bool "Silicon Image HDMI transmitter SiI9022A/9024A support"
	depends on HDMI_ITV
	
config SII92326
	bool "Silicon Image MHL transmitter SiI9232/9236 support"
	select HDMI_USE_IRQ
	depends on HDMI_ITV
	help
        	MHL Transmitter is a HD video transmitter chip 
		over micro-USB connector for mobile device.
config ANX7805
	bool "Analogix Slimport transmitter ANX7805 support(EXPERIMENTAL)"
	depends on HDMI_ITV
	help
        	Slimport Transmitter (SP_TX) is a HD video transmitter chip 
		over micro-USB connector for smartphone device.

config RK610_HDMI
	bool "Rockchip HDMI transimtter RK610(Jetta)"
	depends on HDMI_ITV
	select MFD_RK610
	help
		If you need to use HDMI in RK610(jetta) which is a multifunction 
		device, please select Y. 

config SII9244
	bool  "Silicon Image MHL transmitter SiI9244 support"
	depends on HDMI_ITV
	help
		MHL Transmitter is a HD video transmitter chip over micro-USB 
		connector for mobile device. The SiI9244 device receives HDMI data 
		and transcodes it into a MHL TMDS data stream.
endchoice
```

## drivers/video/display/hdmi/chips/anx7805/Kconfig
```kconfig
config SP_TX
	tristate "Analogix Slimport transmitter ANX7805 support"
	help
        	Slimport Transmitter (SP_TX) is a HD video transmitter chip 
		over micro-USB connector for smartphone device.

       
```

## drivers/video/display/lcd/Kconfig
```kconfig
#
# LCD drivers configuration
#

config DISPLAY_LCD_SUPPORT
	bool "LCD Screen support"
	depends on DISPLAY_SUPPORT
```

## drivers/video/display/tve/Kconfig
```kconfig
#
# TV Encoder drivers configuration
#

menuconfig RK_TVENCODER
	bool "TV Encoder support"
    help
       Support RockChip TV Encoder if you say y here.

source "drivers/video/display/tve/rk610/Kconfig"
source "drivers/video/display/tve/rk1000/Kconfig"
source "drivers/video/display/tve/ch7025/Kconfig"
```

## drivers/video/display/vga/Kconfig
```kconfig
#
# VGA drivers configuration
#

config RK_VGA
	bool "VGA support"
	help
		Support VGA output.
```

## drivers/video/rockchip/hdmi/Kconfig
```kconfig
menuconfig HDMI_RK30
        bool "RK30 HDMI support"
        depends on LCDC_RK30
        select FB_MODE_HELPERS
        help
           Support rk30 hdmi if you say y here

config HDMI_RK30_CTL_CODEC
		bool "Mute Codec When HDMI Actived"
		depends on HDMI_RK30
		default n
		help
			If you say y heres, Codec will be mute when hdmi inserted,
			and unmute when removed. 

config HDMI_RK30_DEBUG
		bool "RK30 HDMI Debugging"
        depends on HDMI_RK30 && LCDC_RK30
        default n
		help
		  Enableds verbose debugging the the HDMI drivers

choice
	prompt "RK30 HDMI output mode select"
	depends on HDMI_RK30
config HDMI_RK30_MODE_ALWAYS_HDMI
	bool "always hdmi"
config HDMI_RK30_MODE_ALWAYS_DVI
	bool "always dvi"
endchoice

choice
	prompt "RK30 HDMI resolution select"
	depends on HDMI_RK30
config HDMI_RK30_RES_720P
	bool "Default fixed resolution is 720P"
config HDMI_RK30_RES_1080P
	bool "Default fixed resolution is 1080P"
endchoice



source "drivers/video/rockchip/hdmi/hdcp/Kconfig"
```
